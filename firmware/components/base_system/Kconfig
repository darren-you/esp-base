## firmware/components/base_system/Kconfig
```kconfig
menu "ESP Base"

    config ESP_BASE_PUBLIC_IP_URL
        string "URL that echoes the device's public address"
        default "https://esp.silicicsoft.com/ip"
        help
            After each broker connection the device GETs this URL once over HTTPS; the plain-text
            body is the address the server saw (normally the router's public IPv4). It is reported
            in the status document as net.public_ip, and the server estimates the device's
            location from it. Empty disables the lookup and public_ip stays null.

    config ESP_BASE_TEST_NO_BROKER
        bool "Test build only: never connect to the MQTT broker"
        default n
        help
            The firmware joins Wi-Fi but never connects to the broker, so it is never
            confirmed and the bootloader rolls back after the 300 s window. Used only to
            verify automatic rollback; release packaging refuses images built with it.

    choice ESP_BASE_TEST_BUSINESS
        prompt "Test build only: built-in business layer that misbehaves"
        default ESP_BASE_TEST_BUSINESS_NONE
        help
            Makes the base firmware (apps/esp_base) carry a business layer named test_fault that
            misbehaves on every boot. Used only to verify the business watchdog and safe mode on
            a real board; release packaging refuses images built with it.

        config ESP_BASE_TEST_BUSINESS_NONE
            bool "none"
        config ESP_BASE_TEST_BUSINESS_PANIC
            bool "abort() 20 s after boot"
        config ESP_BASE_TEST_BUSINESS_HANG
            bool "stop feeding the business watchdog 20 s after boot"
        config ESP_BASE_TEST_BUSINESS_INIT_HANG
            bool "never return from the business init callback"
    endchoice

endmenu
```

## firmware/components/base_wasm/Kconfig
```kconfig
menu "ESP Base WASM"

    config ESP_BASE_TEST_WASM_BENCH
        bool "Test build only: run the WASM memory benchmark instead of the system"
        default n
        help
            The firmware loads an embedded sample application, prints heap and stack usage for
            each phase, and never starts the system layer (no Wi-Fi, no broker). Used only to
            measure the runtime on a board or in QEMU; release packaging refuses images built
            with it.

endmenu
```

## firmware/wasm/base_wasm/Kconfig
```kconfig
menu "ESP Base WASM"

    config ESP_BASE_TEST_WASM_BENCH
        bool "Test build only: run the WASM memory benchmark instead of the system"
        default n
        help
            The firmware loads an embedded sample application, prints heap and stack usage for
            each phase, and never starts the system layer (no Wi-Fi, no broker). Used only to
            measure the runtime on a board or in QEMU; release packaging refuses images built
            with it.

    config ESP_BASE_TEST_WASM_DEPLOY
        bool "Test build only: run the scripted application deployment test instead of the system"
        default n
        help
            The firmware never starts the system layer (no Wi-Fi, no broker). It deploys the
            application packages that the test script placed in flash, one after another, through
            the regular slots, signature checks, trial, commit and rollback; only the download is
            replaced by a copy from flash. Used by tools/wasm_deploy_qemu.py; release packaging
            refuses images built with it.

endmenu
```
