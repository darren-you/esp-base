## firmware/apps/esp_base/main/Kconfig.projbuild
```kconfig
menu "ESP Base"

    config ESP_BASE_TEST_NO_BROKER
        bool "Test build only: never connect to the MQTT broker"
        default n
        help
            The firmware joins Wi-Fi but never connects to the broker, so it is never
            confirmed and the bootloader rolls back after the 300 s window. Used only to
            verify automatic rollback; release packaging refuses images built with it.

endmenu
```

## firmware/apps/mqtt_integration/sdkconfig.defaults
```kconfig
# 只用于实验应用的资源观测，不进入普通基座默认配置。
CONFIG_FREERTOS_USE_TRACE_FACILITY=y
CONFIG_ESP_TIMER_PROFILING=y
```

## firmware/components/mqtt_runtime/Kconfig
```kconfig
menu "ESP Base MQTT integration"
    config EBASE_MQTT_PLAINTEXT_LAB
        bool "Allow plaintext MQTT for isolated integration tests"
        default n
        help
            This marks a lab build. Production artifacts must reject this option.
endmenu
```

## firmware/components/time_runtime/Kconfig
```kconfig
menu "ESP Base time"

    config ESP_BASE_TIME_SERVER
        string "普通 Base 应用使用的 SNTP 服务器"
        default "pool.ntp.org"
        help
            这是构建期服务器名称，不写入持久 Wi-Fi 配置。
            TLS 消费者必须等待本次启动完成有效时间同步。

endmenu
```

## firmware/sdkconfig.defaults
```kconfig
# ESP Base 两个目标共用的选项；目标专属项见 sdkconfig.defaults.<target>。
CONFIG_ESPTOOLPY_FLASHSIZE_4MB=y
CONFIG_PARTITION_TABLE_CUSTOM=y
CONFIG_PARTITION_TABLE_CUSTOM_FILENAME="partitions/partitions.csv"
CONFIG_COMPILER_OPTIMIZATION_SIZE=y

# 原生 A/B 回滚；应用用 RSA-3072（Secure Boot V2 方案）签名，更新时验签，不启用硬件 Secure Boot。
CONFIG_BOOTLOADER_APP_ROLLBACK_ENABLE=y
CONFIG_SECURE_SIGNED_APPS_NO_SECURE_BOOT=y
CONFIG_SECURE_SIGNED_APPS_RSA_SCHEME=y
CONFIG_SECURE_SIGNED_ON_UPDATE_NO_SECURE_BOOT=y
# 构建只产出未签名镜像，由 tools/esp_base.py sign 用仓外的键签名。
CONFIG_SECURE_BOOT_BUILD_SIGNED_BINARIES=n

# 控制任务就是主任务。
CONFIG_ESP_MAIN_TASK_STACK_SIZE=8192
# 状态文档用 uxTaskGetSystemState 报告各任务栈余量。
CONFIG_FREERTOS_USE_TRACE_FACILITY=y
CONFIG_ESP_WIFI_SOFTAP_SUPPORT=n
CONFIG_MBEDTLS_TLS_CLIENT_ONLY=y
CONFIG_LWIP_SNTP_MAX_SERVERS=2
CONFIG_MQTT_PROTOCOL_311=y
CONFIG_MQTT_TRANSPORT_WEBSOCKET=n
CONFIG_ESP_COREDUMP_ENABLE_TO_FLASH=y
```

## firmware/sdkconfig.defaults.esp32
```kconfig
# ESP32-D0WD-V3：RSA 签名方案要求芯片版本不低于 v3.0。
CONFIG_ESP32_REV_MIN_3=y
CONFIG_FREERTOS_UNICORE=y
```

## firmware/tests/nvs-capacity-probe/sdkconfig.defaults
```kconfig
CONFIG_IDF_TARGET="esp32c3"
CONFIG_ESPTOOLPY_FLASHSIZE_4MB=y
CONFIG_PARTITION_TABLE_CUSTOM=y
CONFIG_PARTITION_TABLE_CUSTOM_FILENAME="partitions.csv"
CONFIG_ESP_CONSOLE_UART_DEFAULT=y
CONFIG_ESP_CONSOLE_UART_NUM=0
CONFIG_ESP_CONSOLE_SECONDARY_NONE=y
CONFIG_COMPILER_OPTIMIZATION_SIZE=y
```

## firmware/tests/nvs-capacity-probe/sdkconfig.defaults.esp32
```kconfig
CONFIG_IDF_TARGET="esp32"
CONFIG_ESPTOOLPY_FLASHSIZE_4MB=y
CONFIG_PARTITION_TABLE_CUSTOM=y
CONFIG_ESP_CONSOLE_UART_DEFAULT=y
CONFIG_ESP_CONSOLE_UART_NUM=0
CONFIG_ESP_CONSOLE_SECONDARY_NONE=y
CONFIG_COMPILER_OPTIMIZATION_SIZE=y
CONFIG_WAMR_ENABLE_INTERP=y
CONFIG_WAMR_INTERP_CLASSIC=y
CONFIG_WAMR_INTERP_LOADER_NORMAL=y
CONFIG_WAMR_ENABLE_AOT=n
CONFIG_WAMR_ENABLE_LIBC_BUILTIN=n
CONFIG_WAMR_ENABLE_LIBC_WASI=n
CONFIG_WAMR_ENABLE_LIB_PTHREAD=n
CONFIG_WAMR_ENABLE_MULTI_MODULE=n
CONFIG_WAMR_ENABLE_SHARED_MEMORY=n
CONFIG_WAMR_ENABLE_REF_TYPES=n
```

## firmware/tests/nvs-same-key-probe/sdkconfig.defaults
```kconfig
CONFIG_ESPTOOLPY_FLASHSIZE_4MB=y
CONFIG_PARTITION_TABLE_CUSTOM=y
CONFIG_PARTITION_TABLE_CUSTOM_FILENAME="../../partitions/partition_table.csv"
CONFIG_ESP_CONSOLE_UART_DEFAULT=y
CONFIG_ESP_CONSOLE_UART_NUM=0
```
